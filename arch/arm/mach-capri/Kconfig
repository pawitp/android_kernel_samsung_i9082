## drivers/accessory/Kconfig
```kconfig
#
# mhl drivers configuration
#

menu "Mhl(sii9244) device support"


config SAMSUNG_MHL
        bool "Enable Sii9244 MHL Chip Driver"
        default n
        ---help---
          support Sii9244 MHL Chip Driver


config SAMSUNG_USE_11PIN_CONNECTOR
	bool "11pin micro-usb connector support"
	default n
	---help---
	  use 11pin micro usb connector instead of 5pin

config SAMSUNG_SMARTDOCK
	bool "smartdock support"
	default n

config MHL_CAPRI_REV03
	bool "S2 PLUS REV03"
	default n
	
config MHL_NEW_CBUS_MSC_CMD
	bool "Read DCAP for distinguish TA and USB"
	default n

config VIDEO_MHL_V2
	bool "Enable MHL_V2"
	default n


endmenu
```

## drivers/char/broadcom/Kconfig
```kconfig
#
# Broadcom char driver config
#

menuconfig BRCM_CHAR_DRIVERS
	tristate "Broadcom Char Drivers"
	depends on PROC_FS
	help
	  Broadcom's char drivers

config BRCM_CP_CRASH_DUMP_EMMC
	bool "cp crash dump to eMMC"
	depends on APANIC_ON_MMC && CP_CRASH
        default y
        ---help---
        Say Y to enable the cp crash dump to eMMC support

config V3D
	tristate "V3D Driver"
	depends on BRCM_CHAR_DRIVERS && (ARCH_RHEA)
	default n

config VCE
	tristate "VCE Driver"
	depends on BRCM_CHAR_DRIVERS && (ARCH_RHEA)
	default n

config BRCM_FUSE_LOG
	tristate "Broadcom FUSE LOG drivers"
	depends on BRCM_CHAR_DRIVERS
	default n
	--help---
	  Broadcom FUSE LOG drivers

config STM_DEFAULT
	tristate "STM Driver"
	depends on BRCM_CHAR_DRIVERS
	default n

config ISP
	tristate "ISP Driver"
	depends on BRCM_CHAR_DRIVERS && (ARCH_RHEA)
	default n

config UNICAM
	tristate "UNICAM Driver"
	depends on BRCM_CHAR_DRIVERS && (ARCH_RHEA)
	default n

config BCMPMU_RPC
	bool "Support rpc with bcmpmu driver"
	depends on BRCM_CHAR_DRIVERS
	depends on MFD_BCMPMU
	depends on SENSORS_BCMPMU
	default n
	---help---
	Select to support PMU ADC info to Modem.

config BCM_AP_PANIC_ON_CPCRASH
	bool "Support for crashing AP when CP crashes"
	depends on BRCM_CHAR_DRIVERS && (MACH_CAPRI_SS_COMMON)
	default y
	help
	If you say Y here, a CP crash will result in AP panic.
	Debug tool can be used to extract CP dump later.

config BCM_GPS_UART
	int "GPS UART"
	depends on BCM_GPS
	--help---
		GPS UART port no e.g. 0,1,2,3 to be used

config BCM_MODEM
        bool "Broadcom Modem Driver"
        depends on BRCM_CHAR_DRIVERS && NET
        default n
        help
          Broadcom Modem IPC drivers

config BCM_MODEM_DEFER_CP_START
        bool "Release CP from reset from main image (deferred)"
        depends on BRCM_CHAR_DRIVERS && NET && BCM_MODEM
        default n
        help
          Causes the main image to release the CP from reset in the case
          where this is not done already from the loader.

config BRCM_FUSE_VSP
	boolean "Broadcom FUSE VSP drivers"
	depends on BRCM_CHAR_DRIVERS && BCM_MODEM
	default n
	help
		Broadcom FUSE VSP drivers for video telephony data transfer

config BCM_IDLE_PROFILER
	bool "Broadcom Idle Profiler Support"
	depends on BRCM_CHAR_DRIVERS && ARCH_KONA
	default n
	help
	  Say y to turn on Broadcom idle profiler support

config BCM_PERFTEST_SUPPORT
    tristate "Broadcom Performance Test (perftest) Support"
    default n
    depends on ARCH_KONA && (ARCH_ISLAND || ARCH_CAPRI)
    help
        Memory copy performance test (sDMA, armlib) on selected cpu

config GPIO_USER_MODE_SUPPORT
	tristate "Broadcom GPIO User Mode Support"
	depends on BRCM_CHAR_DRIVERS
	default n
	help
	  Say y to turn on support for GPIO in user mode

config BCM_HEADSET_SW
   bool "Headset Detection Support"
   depends on BRCM_CHAR_DRIVERS
   default y
   ---help---
   Say Y to enable headset detection.

config BCM_AMXR
   bool "Audio Mixer Driver support"
   depends on BRCM_CHAR_DRIVERS
   default n
   ---help---
   Say Y to enable the Audio Mixer Driver to support interconnecting
   audio samples between kernel objects.

config BCM_AMXR_CORE
   tristate "Audio Mixer Driver support"
   depends on BCM_AMXR
   default n
   ---help---
   Say Y to enable the Audio Mixer Core module.

config BCM_HALAUDIO
    bool "HAL Audio Driver support"
    depends on BRCM_CHAR_DRIVERS
    default n
    help
      Say Y to enable HAL Audio Driver support which is used to control
      audio hardware.

config BCM_HALAUDIO_CORE
    tristate "HAL Audio core framework support"
    depends on BRCM_CHAR_DRIVERS && BCM_HALAUDIO
    default n
    help
      Select m to build HAL Audio core framework module which is used to control
      audio hardware.

config BCM_VCP
    bool "Video Calling driver support"
    depends on BRCM_CHAR_DRIVERS
    default n
    help
      Say Y to enable VCP driver support which is used to support
      video calling framework.

config BCM_VCPTEST
    tristate "Video Calling driver test"
    depends on BCM_VCP
    default n
    help
      Say Y to enable VCP driver test.

config BCM_GIST
    tristate "Generic I/O Streaming (GIST)"
    default n
    ---help---
    This utility provides low latency non-blocking reads from and writes to files.

config BCM_SIGMORPH
    tristate "Audio Packet Processing"
    default n
    ---help---
    Codec Streaming eXtensions interface to attenuate/mix audio

config BCM_HDMI_DET
    tristate "HDMI detection"
    default n
    ---help---
    Select to build the generic HDMI dectection driver.

config BCM_HDMI_DET_SWITCH
    bool "HDMI detection switch class extension"
    depends on BCM_HDMI_DET
    default n
    ---help---
    Say Y to enable the switch class support in the HDMI detection driver,
    needed for Android HDMI integration.

config BCM_FRAME_PROFILER_SUPPORT
    bool "Enable frame profiling"
    depends on ARCH_BCM116X || ARCH_BCMRING
    default y
    ---help---
      Maintain a history of time spent processing frames.

config BCM_VC_RESERVE_LOWMEM
   bool "Enable VC low memory reservation"
   depends on BCM_VC_SERVICES
   default n
   ---help---
      Reserves some of the memory which is located at VC's zero page address.
      This is useful if VC code is writing through NULL pointers.

config BCM_VC_SYSMAN_REMOTE
   tristate "Videocore Remote Sysman Interface"
   depends on BCM_VC_SERVICES
   default n
   help
          Allows configuration of ARM-accessible registers from videocore

config BCM_VC_PMU_REQUEST
   tristate "Videocore PMU Request Driver"
   depends on BCM_VC_SERVICES
   default n
   help
   Requests required power supplies on behalf of videocore.

config BCM_WFD
    tristate "WiFi Display Datapath"
    depends on BCM_VC_SERVICES
    default n
    ---help---
    Select to build the generic WiFi Display Datapath driver.

config BCM_VC_OMX
	tristate "Videocore OpenMAX"
   depends on BCM_VC_SERVICES
	default n
        help
          Tracker for videocore openmax capabilities, used in integration
          with Android for multimedia support of StageFright.

config BCM_VC_HNFO
	tristate "Videocore HDMI Information"
   depends on BCM_VC_SERVICES
	default n
        help
          Tracker for videocore hdmi capabilities, used in integration
          with Android for multimedia support.

config BCM_VC_DNFO
	tristate "Videocore Display Information"
   depends on BCM_VC_SERVICES
	default n
        help
          Tracker for videocore display capabilities, used in integration
          with Android.

config BCM_VC_LMK
	tristate "Videocore Low-Memory-Killer"
   depends on BCM_VC_SERVICES
	default n
        help
          Helper for low-memory-killer aware of videocore memory comsumption.

config BCM_VC_MEM
	tristate "Videocore Memory"
   depends on BCM_VC_SERVICES
	default n
        help
          Helper for videocore memory access and total size allocation.

config BCM_VC_FB
	tristate "Videocore Frame Buffer"
	depends on FB && BCM_VC_SERVICES
	select FB_CFB_FILLRECT
	select FB_CFB_COPYAREA
	select FB_CFB_IMAGEBLIT
	default n
        help
          Support for the VC framebuffer on the Broadcom reference
          phone. Uses the VCHIQ stack.

config BCM_VC_SM
	tristate "VMCS Shared Memory"
   depends on BCM_VC_SERVICES
	default n
        help
          Support for the VC shared memory on the Broadcom reference
          design. Uses the VCHIQ stack.

config BCM_VC_CMA
	tristate "Videocore CMA"
   depends on BCM_VC_SERVICES
	default n
        help
          Helper for videocore CMA access.

config BCM_VC_DISPLAY
	tristate "Broadcom VideoCore display device support"
   depends on BCM_VC_SERVICES
	default n
	help
		LCD & backlight device drivers for the Broadcom VideoCore GPU.

config BCM_VC_WATCHDOG
	tristate "Broadcom VideoCore watchdog"
   depends on BCM_VC_SERVICES
	default n
	  help
		This configures the Broadcom VideoCore watchdog.
		This polls the VideoCore GPU regularly when it is awake to ensure
		that it is responding correctly.  If VideoCore is suspended, polling
		will be deferred until it has resumed.
		If VideoCore does not respond within a timely manner, a kernel panic
		will be triggered by the kernel-side code.

config BCM_VC_CAM
	tristate "Videocore CAMera Dualization"
   depends on BCM_VC_SERVICES
	default n
        help
          Helper for videocore CAMD service.

config BCM_REAR_FLASH_TEST
	tristate "rear flash on/off test"
	default n
	help
	  Support for rear flash on/off kernel driver for SS factory test

config BCM_FLIGHTMODE_OPT
	tristate "Broadcom optimization for flight mode"
	default n
        help
          This driver implements several optimization routines that is
          specific for use during flight mode only.

          If in doubt, say N.

source "drivers/char/broadcom/csx/Kconfig"

config BCM_RTC_CAL
    tristate "RTC CAL"
    depends on BCM_MODEM && MFD_BCM59056 && (ARCH_RHEA || ARCH_CAPRI)
    default n
    ---help---
      Select to build the RTC CAL driver.

config BCM_GPS_CNTIN
	boolean "Broadcom gps cntin driver"
	default y
	---help---
	Say Y to enable the GPS CNTIN support.

config BRCM_SIM_SECURE_ENABLE
    boolean "Broadcom SIM Secure Enable"
    depends on BRCM_CHAR_DRIVERS && BCM_MODEM && BRCM_EMMC_RPMB
    default n
    ---help---
    Broadcom SIM Secure Enable
```

## drivers/input/touchscreen/cypress_touchkey/Kconfig
```kconfig
#
# Cypress touchkey configuration
#

config KEYBOARD_CYPRESS_TOUCH
	tristate "Cypress I2C Touchkey"
	depends on I2C
	help
	  Say Y here if you have Cypress I2C Touchkey.

config S2VE_TOUCHKEY_REV05
	bool "Using touchkey power supply for REV05"
	default n
	help
	  Say Y here if you have S2VE Rev05 board.
```

## drivers/misc/modem_if/Kconfig
```kconfig
menuconfig SEC_MODEM
	bool "Samsung Mobile Modem Interface"
	default n
	---help---
	  Samsung Modem Interface Driver.

config TDSCDMA_MODEM_SPRD8803
	bool "modem chip : SPRD SC8803"
	depends on SEC_MODEM
	default n

config LINK_DEVICE_SPI
	bool "modem driver link device SPI"
	depends on SEC_MODEM
	default n

config WORKQUEUE_FRONT
	bool "IPC: SPI workqueue front"
	depends on SEC_MODEM
	default n

config SEC_DUAL_MODEM_MODE
	bool "sec dual modem mode"
	depends on SEC_MODEM
	default n
```

## drivers/misc/vc04_services/Kconfig
```kconfig
config BCM2708_VCHIQ
	tristate "Videocore VCHIQ"
	depends on MACH_BCM2708
	default CONFIG_BCM_VC_SERVICES
	help
		Kernel to VideoCore communication interface for the
		BCM2708 family of products.
		Defaults to Y when the Broadcom Videocore services
		are included in the build, N otherwise.

config KONA_VCHIQ
	tristate "Videocore VCHIQ for 'KONA' architecture"
	depends on ARCH_KONA
	default CONFIG_BCM_VC_SERVICES
	help
		Kernel to VideoCore communication interface for the
		KONA family of products.
		Defaults to Y when the Broadcom Videocore services
		are included in the build, N otherwise.

config KONA_VCHIQ_MEMDRV
	tristate "VCHIQ Internal Videocore (KONA)"
	depends on KONA_VCHIQ
	default CONFIG_BCM_VC_SERVICES
	help
		VideoCore communication interface (memory driver for internal
		VideoCore) for the KONA family.
		Defaults to Y when the Broadcom Videocore services
		are included in the build, N otherwise.

config VCHIQ_PLATFORM_CFG_NAME
	string "VCHIQ platform configuration name"
	help
	  Determines which vchiq platform configuration will be used.
	  The actual configuration file will come from interface/vchiq_arm/<platform-cfg>.mk
	  where <platform-cfg> is the string stored in this configuration variable.
```

## drivers/misc/yas532/Kconfig
```kconfig
menuconfig INPUT_YAS_SENSORS
	bool "Sensors Support"
	help
	  Say Y to enable Sensors support.  This allows control of supported
	  Sensors.

if INPUT_YAS_SENSORS
source "drivers/misc/yas532/accelerometer/Kconfig"
source "drivers/misc/yas532/geomagnetic/Kconfig"
source "drivers/misc/yas532/orientation/Kconfig"
endif # INPUT_YAS_SENSORS
```

## drivers/param/Kconfig
```kconfig
menu "Samsung Param support"
config SAMSUNG_PARAM
	tristate "Samsung Paramter Block system"
	default	m
	help
	  Samsung Android Phone - Parameter control driver
	  param.o
endmenu
```

## drivers/sensors/Kconfig
```kconfig
menuconfig NEW_SENSORS
	bool "Sensors Support"
	help
		Say Y to enable Sensors support. This allows control of supported
		Sensors.

if NEW_SENSORS

source "drivers/sensors/core/Kconfig"

endif
```

## drivers/sensors/core/Kconfig
```kconfig
#
# Sensors core device.
#

config SENSORS_CORE
	tristate "Sensors core"
	help
	  Say Y here to enable debugging messages for power supply class
	  and drivers.
```

## drivers/staging/iio/imu/mpu/Kconfig
```kconfig
#
# inv-mpu-iio driver for Invensense MPU devices and combos
#

config INV_MPU_IIO
	tristate "Invensense MPU devices"
	depends on I2C && SYSFS && IIO && IIO_KFIFO_BUF && IIO_TRIGGER && !INV_MPU
	default n
	help
	  This driver supports the Invensense MPU devices.
	  This includes MPU6050/MPU3050/MPU9150/ITG3500/MPU6500.
	  This driver can be built as a module. The module will be called
	  inv-mpu-iio.

config INV_IIO_MPU3050_ACCEL_SLAVE_BMA250
	bool "Invensense MPU3050 slave accelerometer device for bma250"
	depends on INV_MPU_IIO
	default n
	help
	  This is slave device enable MPU3050 accelerometer slave device.
	  Right now, it is only bma250. For other acceleromter device,
	  it can be added to this menu if the proper interface is filled.
	  There are some interface function to be defined.

config MPU_SENSORS_MPU6500
	bool "MPU6500"
	depends on I2C
	help
	  If you say yes here you get support for the MPU6500 Gyroscope driver
	  This driver can also be built as a module.  If so, the module
	  will be called mpu6500.      
```

## drivers/staging/iio/magnetometer/ami306/Kconfig
```kconfig
#
# Invensense Aichi AMI306 compass IIO driver (inv-ami306-iio)
#

config INV_AMI306_IIO
    tristate "Invensense Aichi AMI306 compass IIO driver"
    depends on I2C && SYSFS && IIO && IIO_SW_RING && IIO_TRIGGER
    default n
    help
      This driver supports the Aichi AMI306 compass. It is the Invensense 
      IIO implementation for the AMI306 compass device. 
      This driver can be built as a module. The module will be called
      inv-ami306-iio.
```
